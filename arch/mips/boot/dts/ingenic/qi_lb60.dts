// SPDX-License-Identifier: GPL-2.0
/dts-v1/;

#include "jz4740.dtsi"
#include <dt-bindings/gpio/gpio.h>

#include <dt-bindings/gpio/gpio.h>

/ {
	compatible = "qi,lb60", "ingenic,jz4740";

	chosen {
		stdout-path = &uart0;
	};

	beeper {
		compatible = "pwm-beeper";
		pwms = <&pwm 4 0 0>;

		pinctrl-names = "default";
		pinctrl-0 = <&pins_pwm4>;
	};

	mmc_power: fixedregulator {
		compatible = "regulator-fixed";
		regulator-name = "mmc_vcc";
		gpio = <&gpd 2 GPIO_ACTIVE_LOW>;

		regulator-min-microvolt = <3300000>;
		regulator-max-microvolt = <3300000>;
	};
};

&ext {
	clock-frequency = <12000000>;
};

&rtc_dev {
	system-power-controller;
};

&uart0 {
	pinctrl-names = "default";
	pinctrl-0 = <&pins_uart0>;
};

&pinctrl {
	pins_uart0: uart0 {
		function = "uart0";
		groups = "uart0-data";
		bias-disable;
	};

	pins_mmc: mmc {
		mmc {
			function = "mmc";
			groups = "mmc-1bit", "mmc-4bit";
			bias-disable;
		};

		mmc-gpios {
			pins = "PD0", "PD2";
			bias-disable;
		};

	pins_nand: nand {
		nand-cs {
			function = "nand";
			groups = "nand-cs1";
			bias-pull-up;
		};

		nand-busy {
			pins = "PC30";
			bias-disable;
		};
	};

	pins_pwm4: pwm4 {
		function = "pwm4";
		groups = "pwm4";
		bias-disable;
	};
};

&tcu {
	/* 750 kHz for the system timer and clocksource */
	assigned-clocks = <&tcu TCU_CLK_TIMER0>, <&tcu TCU_CLK_TIMER1>;
	assigned-clock-rates = <750000>, <750000>;
};

&mmc {
	bus-width = <4>;
	max-frequency = <48000000>;
	cd-gpios = <&gpd 0 GPIO_ACTIVE_HIGH>;
	vmmc-supply = <&mmc_power>;

	pinctrl-names = "default";
	pinctrl-0 = <&pins_mmc>;
};

&nand {
	status = "okay";

	ingenic,oob-layout = "qi,lb60";

	busy-gpios = <&gpc 30 GPIO_ACTIVE_HIGH>;

	pinctrl-names = "default";
	pinctrl-0 = <&pins_nand>;

	partitions {
		compatible = "fixed-partitions";
		#address-cells = <1>;
		#size-cells = <1>;

		boot@0 {
			reg = <0x0 0x400000>;
		};

		kernel@400000 {
			reg = <0x400000 0x400000>;
		};

		rootfs@800000 {
			reg = <0x800000 0x0>;
		};
	};
};
