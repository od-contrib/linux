## drivers/usb/dwc2/Kconfig
```kconfig
config USB_DWC2
	tristate "DesignWare Core USB 2.0 Hi-Speed On-The-Go(OTG)"
	depends on USB_SUPPORT
	help
	  Say Y or M here if your system has a Dual Role SuperSpeed
	  USB controller based on the DesignWare USB2.0 IP Core.

	  If you choose to build this driver is a dynamically linked
	  module, the module will be called dwc2.ko.

if USB_DWC2

choice
	prompt "Driver Mode"
	help
	  Select Driver Mode

config USB_DWC2_DUAL_ROLE
	bool "Both Host and Device"
	depends on (USB && USB_GADGET)
	help
	  Say Y here to enable both Host and Device function

config USB_DWC2_HOST_ONLY
	bool "Host Mode Only"
	depends on USB
	help
	  Say Y here to enable Host function only

config USB_DWC2_DEVICE_ONLY
	bool "Device Mode Only"
	depends on USB_GADGET
	help
	  Say Y Here to enable Device function only

endchoice

config USB_DWC2_ALLOW_WAKEUP
       bool "allow wakeup when usb cable plug/unplug"
       depends on (USB_DWC2_DUAL_ROLE || USB_DWC2_DEVICE_ONLY)
       default y
       help
         Say Y here if you want usb cable plug/unplug to wakeup the system

config BOARD_HAS_NO_DETE_FACILITY
       bool "board has no plug detect facility"
       default n
       help
         Say Y here if your board has no plug detect facility

config USB_DWC2_DEBUG
	bool "Enable Debugging(dev_dbg) Messages"
	help
	  Say Y here to enable debugging messages on DWC2 Driver.

config USB_DWC2_VERBOSE
	bool "Enable Verbose Debugging(dev_vdbg) Messages"
	depends on USB_DWC2_DEBUG
	help
	  Say Y here to enable verbose debugging messages on DWC2 Driver.

config USB_CHARGER_SOFTWARE_JUDGE
	bool "Enable software to judge connect to usb adapter or host"
	depends on (USB_DWC2_DUAL_ROLE || USB_DWC2_DEVICE_ONLY)
	default n
	help
		Say Y here if you want increase usb charger current limit,
		when connect to adapter

config USB_DWC2_VERBOSE_VERBOSE
	bool "Enable Very Verbose Debugging Messagers"
	default y
	help
	  enable debugging messages for developer debug, these debugging messages
          are switchable write 1 to file under /sys/module/dwc2/parameters/,
          the default value is 0, so you can always say Y here and won't get boring.

config USB_DWC2_HOST_TRACER
	bool "Enable tracing host operation flow"
	depends on (USB_DWC2_DUAL_ROLE || USB_DWC2_HOST_ONLY)
	help
	  Say Y here to enable tracing host operation flow,
	  you must reserve 192M~256M memory

config USB_DWC2_INPUT_EVDEV
       bool "Enable host mode device wakeup"
       depends on (USB_DWC2_DUAL_ROLE || USB_DWC2_HOST_ONLY)
       help
         Say Y here to enable host device insert to wakeup screen

endif
```

## sound/soc/jz4780/Kconfig
```kconfig
config SND_JZ4780_SOC
	tristate "SoC Audio for Ingenic JZ4780 SoC"
	depends on SOC_4780 && SND_SOC
	help
	  Say Y or M if you want to add support for codecs attached to
	  the JZ4780.

	  The JZ4780 includes support for both audio input & output with
	  a built-in codec, DACs & ADCs in addition to support for using
	  a codec external to the SoC. This option only enables support
	  for transferring data to & from the AIC block, you will also
	  need to select the audio interfaces to support below.

config SND_JZ4780_SOC_I2S
	depends on SND_JZ4780_SOC
	tristate "SoC Audio (I2S protocol) for Ingenic JZ4780 SoC"
	help
	  Say Y if you want to use the I2S protocol and I2S codec on
	  Ingenic JZ4780 based boards.

	  The I2S protocol is used to communicate with the internal
	  codec of the JZ4780, so it is likely that you will need to
	  enable this option.

config SND_JZ4780_SOC_CI20
	tristate "SoC Audio support for CI20"
	depends on SND_JZ4780_SOC && BOARD_CI20
	select SND_JZ4780_SOC_I2S
	select SND_SOC_JZ4780_CODEC
	help
	  Say Y if you want to add support for ASoC audio on the CI20 board.
```
